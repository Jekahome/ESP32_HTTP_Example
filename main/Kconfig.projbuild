## main/Kconfig.projbuild
```kconfig
menu "ESP Station IoT Example Configuration"

    config MQTT_BROKER_URL
        string "Broker URL"
        default "mqtt://192.168.1.167"
        help
            URL of the broker to connect to (mqtt://192.168.1.167, mqtt://mqtt.eclipseprojects.io)
            
    config BROKER_BIN_SIZE_TO_SEND
        # This option is not visible and is used only to set parameters for example tests
        # Here we configure the data size to send and to be expected in the python script
        int
        default 20000

    config MQTT_BROKER_AUTH_USERNAME
        string "Broker URL"
        default "Jeka"
        help
            Username Authentication.  

    config MQTT_BROKER_AUTH_PASSWORD
        string "Broker URL"
        default "1234"
        help
            Password Authentication.    
                                
    config EXAMPLE_BASIC_AUTH
        bool "Authentication"
        default y
        help
            Authentication support.
        
    config EXAMPLE_BASIC_AUTH_USERNAME
        depends on EXAMPLE_BASIC_AUTH
        string "Username"
        default "Jeka"
        help
            Username Authentication.  

    config EXAMPLE_BASIC_AUTH_PASSWORD
        depends on EXAMPLE_BASIC_AUTH
        string "Password"
        default "1234"
        help
            Password Authentication.              
            
    config ESP_WIFI_SSID
        string "WiFi SSID"
        default "MIWIFI_MAmm"
        help
            SSID (network name) for the example to connect to.
 
    config ESP_WIFI_PASSWORD
        string "WiFi Password"
        default "7ubmt6UJ"
        help
            WiFi password (WPA or WPA2) for the example to use.
 
    config HTTPD_MAX_REQ_HDR_LEN
        int "Max HTTP Request Header Length"
        default 1024
        help
            Max HTTP Request Header Length.
          

    config ESP_MAXIMUM_RETRY
        int "Maximum retry"
        default 5
        help
            Set the Maximum retry to avoid station reconnecting to the AP unlimited when the AP is really inexistent.

    config ESP_WIFI_CHANNEL
        int "WiFi Channel"
        range 1 13
        default 1
        help
            WiFi channel (network channel) for the example to use.

    config EXAMPLE_FORMAT_IF_MOUNT_FAILED
        bool "Format the card if mount failed"
        default n
        help
            If this config item is set, format_if_mount_failed will be set to true and the card will be formatted if
            the mount has failed.
  
    config EXAMPLE_STATIC_IP_ADDR
        string "Static IP address"
        default "192.168.1.166"
        help
            Set static IP address.

    config EXAMPLE_STATIC_NETMASK_ADDR
        string "Static netmask address"
        default "255.255.255.0"
        help
            Set static netmask address.

    config EXAMPLE_STATIC_GW_ADDR
        string "Static gateway address"
        default "192.168.1.255"
        help
            Set static gateway address.

    choice EXAMPLE_STATIC_DNS_SERVER
        prompt "Choose DNS server"
        default EXAMPLE_STATIC_DNS_AUTO
        help
            Select auto to make gateway address as DNS server or manual to input your DNS server
        config EXAMPLE_STATIC_DNS_AUTO
            bool "Use gateway address as DNS server"
            help
                Set DNS server the same as gateway address

        config EXAMPLE_STATIC_DNS_MANUAL
            bool "Set manual value as DNS server"
            help
                Set DNS server with you want
    endchoice

    config EXAMPLE_STATIC_DNS_SERVER_MAIN
        string "Main DNS server address"
        default "192.168.0.1"
        depends on EXAMPLE_STATIC_DNS_MANUAL
        help
            Set main DNS server address.

    config EXAMPLE_STATIC_DNS_SERVER_BACKUP
        string "Backup DNS server address"
        default "192.168.0.1"
        depends on EXAMPLE_STATIC_DNS_MANUAL
        help
            Set backup DNS server address. It can be same with the main DNS server address or leave empty.

    config EXAMPLE_STATIC_DNS_RESOLVE_TEST
        bool "Enable DNS resolve test"
        default n
        help
            Enable it and configure EXAMPLE_STATIC_RESOLVE_DOMAIN to resolve DNS domain name

    config EXAMPLE_STATIC_RESOLVE_DOMAIN
        string "Domain name to resolve"
        default "www.espressif.com"
        depends on EXAMPLE_STATIC_DNS_RESOLVE_TEST
        help
            Set domain name for DNS test       
 endmenu
```

## sdkconfig.defaults
```kconfig
# ;Скорость работы с монитором 921600,230400,115200,57600,9600
# monitor_speed = 115200

# Serial flasher config

CONFIG_ESPTOOLPY_BAUD_OTHER_VAL=115200
CONFIG_ESPTOOLPY_MONITOR_BAUD_115200B=y
CONFIG_ESPTOOLPY_MONITOR_BAUD_OTHER_VAL=115200
CONFIG_ESPTOOLPY_MONITOR_BAUD=115200
# 9600 bps (CONFIG_ESPTOOLPY_MONITOR_BAUD_9600B)
# 57600 bps (CONFIG_ESPTOOLPY_MONITOR_BAUD_57600B)
# 115200 bps (CONFIG_ESPTOOLPY_MONITOR_BAUD_115200B)
# 230400 bps (CONFIG_ESPTOOLPY_MONITOR_BAUD_230400B)
# 921600 bps (CONFIG_ESPTOOLPY_MONITOR_BAUD_921600B)
# 2 Mbps (CONFIG_ESPTOOLPY_MONITOR_BAUD_2MB)

# Common ESP-related

CONFIG_ESP_CONSOLE_UART_BAUDRATE=115200

# Compatibility options
# Устаревшие варианты и их замены CONFIG_MONITOR_BAUD => CONFIG_ESPTOOLPY_MONITOR_BAUD

# WiFi
CONFIG_ESP_HTTPS_SERVER_ENABLE=y # HTTPS
CONFIG_EXAMPLE_CONNECT_WIFI=y
#CONFIG_ESP_WIFI_SSID="Jeka"               # from Kconfig.projbuild
#CONFIG_ESP_WIFI_PASSWORD="13021985Jeka"   # from Kconfig.projbuild
#CONFIG_ESP_MAXIMUM_RETRY=3                # from Kconfig.projbuild
#CONFIG_ESP_WIFI_CHANNEL=1                 # from Kconfig.projbuild

# WiFi Maximum throughput
CONFIG_ESP32_DEFAULT_CPU_FREQ_240=y
#CONFIG_ESP32_DEFAULT_CPU_FREQ_160=y
CONFIG_ESP32_DEFAULT_CPU_FREQ_MHZ=240 #160
CONFIG_MEMMAP_SMP=y
CONFIG_ESP_SYSTEM_EVENT_TASK_STACK_SIZE=4096 # 2304 4096
CONFIG_FREERTOS_UNICORE=n
CONFIG_FREERTOS_HZ=1000
CONFIG_ESP_INT_WDT=n
CONFIG_ESP_TASK_WDT=n
CONFIG_LWIP_ETHARP_TRUST_IP_MAC=n
CONFIG_LWIP_IRAM_OPTIMIZATION=y
CONFIG_LWIP_MAX_SOCKETS=6
CONFIG_LWIP_IPV6=n
CONFIG_LWIP_TCPIP_RECVMBOX_SIZE=4096 #1024 512 #CONFIG_LWIP_WND_SCALE
CONFIG_LWIP_TCPIP_TASK_STACK_SIZE=65536 # default 3072
CONFIG_LWIP_TCPIP_TASK_AFFINITY=y
CONFIG_ESP32_WIFI_TX_BUFFER=ESP32_WIFI_DYNAMIC_TX_BUFFER
CONFIG_ESP32_WIFI_DYNAMIC_TX_BUFFER_NUM=128

# UDP
CONFIG_LWIP_MAX_UDP_PCBS=2
CONFIG_LWIP_UDP_RECVMBOX_SIZE=64

# Static IP  
#CONFIG_EXAMPLE_STATIC_IP_ADDR="192.168.0.109" # from Kconfig.projbuild
#CONFIG_EXAMPLE_STATIC_NETMASK_ADDR="255.255.255.0" # from Kconfig.projbuild
#CONFIG_EXAMPLE_STATIC_GW_ADDR="192.168.0.255" # from Kconfig.projbuild
CONFIG_EXAMPLE_STATIC_DNS_SERVER=n
#CONFIG_EXAMPLE_STATIC_DNS_SERVER_MAIN="192.168.0.1" # from Kconfig.projbuild
#CONFIG_EXAMPLE_STATIC_DNS_SERVER_BACKUP="192.168.0.1" # from Kconfig.projbuild
CONFIG_EXAMPLE_STATIC_DNS_RESOLVE_TEST=n
CONFIG_EXAMPLE_STATIC_RESOLVE_DOMAIN="www.jeka_espressif.com"


# -------------------------------
# ; QIO QOUT DIO DOUT По производительности: QIO> QOUT> DIO> DOUT
# board_build.flash_mode = dio
# можно установить через `idf.py menuconfig` => Serial flasher config
# Serial flasher config

CONFIG_ESPTOOLPY_FLASHMODE_DIO=y
CONFIG_ESPTOOLPY_FLASHMODE="dio"

# QIO (CONFIG_ESPTOOLPY_FLASHMODE_QIO)
# QOUT (CONFIG_ESPTOOLPY_FLASHMODE_QOUT)
# DIO (CONFIG_ESPTOOLPY_FLASHMODE_DIO)
# DOUT (CONFIG_ESPTOOLPY_FLASHMODE_DOUT)
# OPI (CONFIG_ESPTOOLPY_FLASHMODE_OPI)
 
# -------------------------------
# ; set frequency to 40MHz
# board_build.f_flash = 40000000L
#
# Serial flasher config
#
CONFIG_ESPTOOLPY_FLASHFREQ_80M=y
CONFIG_ESPTOOLPY_FLASHFREQ="80m"
# 120 MHz (CONFIG_ESPTOOLPY_FLASHFREQ_120M)
# 80 MHz (CONFIG_ESPTOOLPY_FLASHFREQ_80M)
# 40 MHz (CONFIG_ESPTOOLPY_FLASHFREQ_40M)
# 26 MHz (CONFIG_ESPTOOLPY_FLASHFREQ_26M)
# 20 MHz (CONFIG_ESPTOOLPY_FLASHFREQ_20M)

# -------------------------------
# Serial flasher config
#
# CONFIG_ESPTOOLPY_FLASHSIZE_1MB   
# CONFIG_ESPTOOLPY_FLASHSIZE_2MB=y
 CONFIG_ESPTOOLPY_FLASHSIZE_4MB=y 
# CONFIG_ESPTOOLPY_FLASHSIZE_8MB  
# CONFIG_ESPTOOLPY_FLASHSIZE_16MB  
CONFIG_ESPTOOLPY_FLASHSIZE="4MB"
# или определить по плате
CONFIG_ESPTOOLPY_FLASHSIZE_DETECT=n
# --------------------------------

# ; Скорость загрузки в baud
# upload_speed = 115200
# не найдено

# --------------------------------
# upload_port = /dev/ttyUSB0
# ;monitor_port = /dev/ttyUSB0
# при запуске idf.py  -p /dev/ttyUSB0

# --------------------------------
# ; set frequency to 160MHz
# board_build.f_cpu = 160000000L

# ESP32-specific

# CONFIG_ESP32_DEFAULT_CPU_FREQ_80 
CONFIG_ESP32_DEFAULT_CPU_FREQ_160=y
# CONFIG_ESP32_DEFAULT_CPU_FREQ_240 
CONFIG_ESP32_DEFAULT_CPU_FREQ_MHZ=160
# --------------------------------
# ; build_flags https://docs.platformio.org/en/latest/projectconf/section_env_build.html?highlight=build_flags#build-flags
# ; флаги https://habr.com/ru/post/490850/
# ; Debug level
# build_flags  
#    -D CORE_DEBUG_LEVEL=4
#    -D CONFIG_BLINK_GPIO=2
#    -Werror=unused-label
#    -Wno-unused-but-set-variable 
#    -Wno-unused-parameter 
#    -Wno-unused-variable
#    ;-Wunused-variable

# не найдено, возможно при компиляции можно передать
# --------------------------------
# Partition Table
# https://docs.espressif.com/projects/esp-idf/en/latest/esp32/api-reference/kconfig.html#config-partition-table-offset

# ;Partition Scheme Huge APP (3Mb No OTA/1Mb SPIFFS)
# ;# Name,   Type, SubType, Offset,  Size, Flags
# ;nvs,      data, nvs,     0x9000,  0x5000,
# ;otadata,  data, ota,     0xe000,  0x2000,
# ;app0,     app,  ota_0,   0x10000, 0x300000,
# ;spiffs,   data, spiffs,  0x310000,0xF0000,

# ;Partition Scheme Huge APP (2Mb No OTA/2Mb SPIFFS)
# ;# Name,   Type, SubType, Offset,  Size, Flags
# ;nvs,      data, nvs,     0x9000,  0x5000,
# ;otadata,  data, ota,     0xe000,  0x2000,
# ;app0,     app,  ota_0,   0x10000, 0x200000,
# ;spiffs,   data, spiffs,  0x210000,0x1F0000,

# board_build.partitions = partitions.csv

# CONFIG_PARTITION_TABLE_SINGLE_APP
# CONFIG_PARTITION_TABLE_TWO_OTA
  CONFIG_PARTITION_TABLE_CUSTOM=y
  CONFIG_PARTITION_TABLE_CUSTOM_FILENAME="partitions/partitions.csv"
# CONFIG_PARTITION_TABLE_FILENAME="partitions_singleapp.csv"
# CONFIG_PARTITION_TABLE_OFFSET=0x8000
# CONFIG_PARTITION_TABLE_MD5=y

# PHY
# CONFIG_ESP32_PHY_INIT_DATA_IN_PARTITION is not set

# SPIFFS Configuration
CONFIG_SPIFFS_MAX_PARTITIONS=3

# Certificate Bundle
CONFIG_MBEDTLS_CERTIFICATE_BUNDLE=n
CONFIG_MBEDTLS_CERTIFICATE_BUNDLE_DEFAULT_FULL=n
```
